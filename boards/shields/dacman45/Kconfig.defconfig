## boards/shields/dacman45/Kconfig.defconfig
```kconfig
if SHIELD_DACMAN45_LEFT

config ZMK_KEYBOARD_NAME
    default "DacMan45"

config ZMK_SPLIT_ROLE_CENTRAL
    default y

endif

if SHIELD_DACMAN45_LEFT || SHIELD_DACMAN45_RIGHT

config ZMK_SPLIT
    default y

endif
```

## boards/shields/dacman45/Kconfig.shield
```kconfig
# SPDX-License-Identifier: MIT

config SHIELD_DACMAN45_LEFT
    def_bool $(shields_list_contains,dacman45_left)

config SHIELD_DACMAN45_RIGHT
    def_bool $(shields_list_contains,dacman45_right)

config SHIELD_DACMAN45_DONGLE
    def_bool $(shields_list_contains,dacman45_dongle)
```
